## team-NMP/conf/layer.conf
```bitbake
# We have a conf and classes directory, add to BBPATH
BBPATH .= ":${LAYERDIR}"

# We have recipes-* directories, add to BBFILES
BBFILES += "${LAYERDIR}/recipes-*/*/*.bb \
            ${LAYERDIR}/recipes-*/*/*.bbappend"

BBFILE_COLLECTIONS += "meta-NMP"
BBFILE_PATTERN_meta-NMP = "^${LAYERDIR}/"
BBFILE_PRIORITY_meta-NMP = "6"

LAYERDEPENDS_meta-NMP = "core"
LAYERSERIES_COMPAT_meta-NMP = "kirkstone"
```
